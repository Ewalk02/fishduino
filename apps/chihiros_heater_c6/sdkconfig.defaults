## main/Kconfig.projbuild
```kconfig
menu "AquaPilot Configuration"

    # Waveshare ESP32-P4-WIFI6 boards use an onboard ESP32-C6 over SDIO.
    # Coprocessor/transport (SLAVE_IDF_TARGET_*, ESP_HOSTED_*) are set via
    # sdkconfig.defaults.hosted in scripts/build-target.sh after managed-component
    # Kconfig exists—not via select on external choice symbols.
    config FISHDUINO_ESP_HOSTED_C6_SDIO
        bool "ESP-Hosted: ESP32-C6 coprocessor over SDIO (Waveshare P4)"
        default y
        help
            Project marker for Waveshare P4 + onboard C6. Actual ESP-Hosted and
            esp_wifi_remote options are applied by the build script.

    choice FISHDUINO_BOARD_TARGET
        prompt "AquaPilot board/display target"
        default FISHDUINO_BOARD_4IN
        help
            Select the Waveshare board + panel at build time.
            The firmware does not auto-detect the panel before display init.

        config FISHDUINO_BOARD_4IN
            bool "ESP32-P4-WIFI6 + 4 inch DSI Touch (480x800 portrait)"

        config FISHDUINO_BOARD_7B
            bool "ESP32-P4-WIFI6-7inch-Touch-LCD (B) (1024x600 landscape)"
    endchoice

    config ESP_WIFI_SSID
        string "WiFi SSID"
        default ""
        help
            Home Wi-Fi network name (2.4 GHz). Set via idf.py menuconfig.
            Saved in sdkconfig (gitignored).

    config ESP_WIFI_PASSWORD
        string "WiFi Password"
        default ""
        help
            Wi-Fi password (WPA2/WPA3). Leave empty for open networks.

    choice FISHDUINO_FLUVAL_DEFAULT_TRANSPORT
        prompt "Fluval default transport"
        default FISHDUINO_FLUVAL_DEFAULT_TRANSPORT_DISABLED
        help
            Default Fluval transport when enabled in NVS settings.
            Hosted BLE uses the onboard ESP32-C6 via ESP-Hosted (SDIO).
            UART helper is an optional external board fallback.

        config FISHDUINO_FLUVAL_DEFAULT_TRANSPORT_DISABLED
            bool "Disabled"
        config FISHDUINO_FLUVAL_DEFAULT_TRANSPORT_HOSTED_BLE
            bool "Hosted BLE (onboard ESP32-C6)"
            select FISHDUINO_FLUVAL_HOSTED_BLE
        config FISHDUINO_FLUVAL_DEFAULT_TRANSPORT_UART
            bool "UART helper fallback"
    endchoice

    config FISHDUINO_FLUVAL_HOSTED_BLE
        bool
        default n
        help
            Build hosted NimBLE Fluval transport (requires ESP-Hosted BT on C6).

    config FISHDUINO_HEADLESS
        bool "Headless mode (skip display/touch/LVGL)"
        default n
        help
            Skip MIPI DSI display, touch, and LVGL UI initialization.
            Console, water metrics, maintenance tracker, Shelly/CO2,
            Wi-Fi, and BLE backends still run. Use when the DSI panel
            is not connected.

endmenu
```

## tools/fluval_ble_helper/sdkconfig.defaults
```kconfig
CONFIG_BT_ENABLED=y
CONFIG_BT_NIMBLE_ENABLED=y
CONFIG_BT_NIMBLE_ROLE_CENTRAL=y
CONFIG_BT_NIMBLE_ROLE_PERIPHERAL=n
CONFIG_BT_NIMBLE_SM_LEGACY=y
CONFIG_BT_NIMBLE_SM_SC=y

CONFIG_ESP_CONSOLE_UART_DEFAULT=y
CONFIG_ESP_CONSOLE_UART_NUM=0
CONFIG_ESP_CONSOLE_UART_BAUDRATE=115200

CONFIG_LOG_DEFAULT_LEVEL_INFO=y
```
